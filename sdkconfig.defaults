## sdkconfig.defaults
```kconfig
# Target: ESP32-P4 (RISC-V)
CONFIG_IDF_TARGET="esp32p4"
CONFIG_ESP32P4_REV_MIN=103
# Enable rev < 3.0 (v1.3 silicon); CONFIG_ESP32P4_REV_MIN=103 may be ignored by this IDF
CONFIG_ESP32P4_SELECTS_REV_LESS_V3=y
CONFIG_ESP32P4_REV_MIN_100=y

# Size optimizations (Embedded Swift, keep binary small)
CONFIG_COMPILER_OPTIMIZATION_SIZE=y
CONFIG_COMPILER_OPTIMIZATION_ASSERTIONS_DISABLE=y
CONFIG_COMPILER_OPTIMIZATION_CHECKS_SILENT=y
CONFIG_COMPILER_OPTIMIZATION_LEVEL_RELEASE=y

# UART0 console (serial monitor)
CONFIG_ESP_CONSOLE_UART_DEFAULT=y
CONFIG_ESP_CONSOLE_UART_NUM=0
CONFIG_ESP_CONSOLE_UART_BAUDRATE=115200

# PSRAM: Waveshare ESP32-P4-ETH has 32MB stacked PSRAM (ESP32-P4NRW32)
# Enable in menuconfig if needed; options vary by ESP-IDF version
# CONFIG_SPIRAM=y

# FreeRTOS (required for vTaskDelay, configTICK_RATE_HZ)
CONFIG_FREERTOS_HZ=1000
CONFIG_FREERTOS_UNICORE=n

# Minimal build where applicable
CONFIG_ESP_SYSTEM_EVENT_TASK_STACK_SIZE=2048
CONFIG_ESP_MAIN_TASK_STACK_SIZE=4096
```
